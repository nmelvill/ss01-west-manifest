## west.yml
```yaml
manifest:
  self:
    path: ss01-west-manifest
  
  remotes:
    - name: ncs
      url-base: https://github.com/nrfconnect
    - name: nmelville
      url-base: git@github.com:nmelvill

  projects:
    - name: nrf
      remote: ncs
      repo-path: sdk-nrf
      revision: v3.0.0
      import: true
    - name: ss01-firmware
      remote: nmelville
      repo-path: ss01-firmware
      revision: main 
```
